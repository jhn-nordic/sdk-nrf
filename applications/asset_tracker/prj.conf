## CMakeLists.txt
```
#
# Copyright (c) 2018 Nordic Semiconductor
#
# SPDX-License-Identifier: LicenseRef-BSD-5-Clause-Nordic
#

cmake_minimum_required(VERSION 3.8.2)

include(../../cmake/boilerplate.cmake)

include($ENV{ZEPHYR_BASE}/cmake/app/boilerplate.cmake NO_POLICY_SCOPE)
project(asset_tracker)
zephyr_compile_definitions(PROJECT_NAME=${PROJECT_NAME})

# NORDIC SDK APP START
target_sources(app PRIVATE src/main.c)
# NORDIC SDK APP END
zephyr_include_directories(src)

# Include application events and configuration headers
zephyr_library_include_directories(
  src/orientation_detector
  src/ui
  src/cloud_codec
  src/battery_monitor
  )

# Application sources
add_subdirectory(src/orientation_detector)
add_subdirectory(src/ui)
add_subdirectory(src/cloud_codec)
add_subdirectory(src/gps_controller)
add_subdirectory(src/battery_monitor)

include_directories(src/env_sensors)

if (CONFIG_USE_BME680_BSEC)
	target_sources(app PRIVATE src/env_sensors//bsec.c)

	set (bsec_dir ${CMAKE_CURRENT_SOURCE_DIR}/src/env_sensors/BSEC_1.4.7.3_Generic_Release)
	include_directories(${bsec_dir}/API)
	target_sources(app PRIVATE ${bsec_dir}/examples/bsec_integration.c)
	include_directories(${bsec_dir}/examples)
	target_sources(app PRIVATE ${bsec_dir}/API/bme680.c)

	set(BSEC_LIB_DIR ${bsec_dir}/algo/bin/Normal_version/gcc/Cortex_M4F)
	set(BSEC_INCLUDE_DIR ${bsec_dir}/algo/bin/Normal_version/gcc/Cortex_M4F)
	add_library(bsec_lib STATIC IMPORTED GLOBAL)
	add_dependencies(bsec_lib math_lib bsec_target)
	set_target_properties(bsec_lib PROPERTIES IMPORTED_LOCATION "${BSEC_LIB_DIR}/libalgobsec.a")
	set_target_properties(bsec_lib PROPERTIES INTERFACE_INCLUDE_DIRECTORIES ${BSEC_INCLUDE_DIR})
	target_link_libraries(bsec_lib INTERFACE -L${LIBC_LIBRARY_DIR})
	target_link_libraries(app PUBLIC bsec_lib)
else()
	target_sources(app PRIVATE src/env_sensors/env_sensors.c)
endif()
```

## Kconfig
```
#
# Copyright (c) 2018 Nordic Semiconductor ASA
#
# SPDX-License-Identifier: LicenseRef-BSD-5-Clause-Nordic
#

menu "Asset tracker"

rsource "src/ui/Kconfig"

menu "GPS"

choice
	prompt "GPS device"
	default GPS_USE_SIM
	help
		Select from which device GPS data will be fetched.

config GPS_USE_SIM
	bool "Use GPS simulator"
	select GPS_SIM
	select GPS_SIM_TRIGGER
	help
		Use simulated GPS data.

config GPS_USE_EXTERNAL
	bool "User provided GPS device"
	help
		Provide a GPS device that location data will be fetched from and
		sent to nRF Cloud

rsource "src/gps_controller/Kconfig"

endchoice

config GPS_DEV_NAME
	string "GPS device name"
	default GPS_SIM_DEV_NAME if GPS_USE_SIM
	help
		GPS device from which location data will be fetched and sent
		to nRF Cloud.

config GPS_TRIGGER
	bool
	default GPS_SIM_TRIGGER if GPS_USE_SIM

endmenu	# GPS

config CLOUD_BUTTON
	bool "Enable button sensor"
	default y

config CLOUD_BUTTON_INPUT
	int "Enable button sensor"
	range 1 4 if BOARD_NRF9160_PCA10090NS
	range 1 1 if BOARD_NRF9160_PCA20035NS
	default 1

config POWER_OPTIMIZATION_ENABLE
	bool "Enable power optimization"
	default y
	select LTE_EDRX_REQ

config USE_AT_HOST
	bool "Enable AT commands"
	default y
	select AT_HOST_LIBRARY
	help
		Enable the AT host library so that AT commands can be sent to and
		received from a serial terminal.

config GPS_SIM_TRIGGER_TIMER_MSEC
	int
	default 120000 if POWER_OPTIMIZATION_ENABLE
	default 2000

config MQTT_KEEPALIVE
	int
	default 1000 if POWER_OPTIMIZATION_ENABLE
	default GPS_CONTROL_FIX_TRY_TIME if GPS_USE_EXTERNAL
	default 120

choice
	prompt "Accelerometer device"
	default ACCEL_USE_SIM
	help
		Select which device will provide accelerometer data.

config ACCEL_USE_SIM
	bool "Use simulated accelerometer data"
	select SENSOR
	select SENSOR_SIM
	select SENSOR_SIM_TRIGGER
	select SENSOR_SIM_STATIC_VALUES
	help
		Use sensor simulator to generate accelerometer data for
		flip detection data sent to nRF Cloud.

config ACCEL_USE_EXTERNAL
	bool "User provided accelerometer device"
	help
		The user will provide an accelerometer device that will
		be used for flip detection.

endchoice

if ACCEL_USE_SIM
config ACCEL_DEV_NAME
	string
	default SENSOR_SIM_DEV_NAME

config ACCEL_TRIGGER
	bool
	default SENSOR_SIM_TRIGGER

config FLIP_INPUT
	int "Button or switch number to simulate flip"
	range 1 4 if BOARD_NRF9160_PCA10090NS
	range 1 1 if BOARD_NRF9160_PCA20035NS
	default 3 if BOARD_NRF9160_PCA10090NS
	default 1 if BOARD_NRF9160_PCA20035NS
	help
		Button or switch number to use for simulating
		a board flip event.
		1 - Button 1
		2 - Button 2
		3 - Switch 1
		4 - Switch 2
endif

config FLIP_POLL
	bool "Use polling to detect flip"
	help
		Poll the defined accelerometer device at interval determined by
		FLIP_POLL_INTERVAL. Data will be sent to nRF Cloud if a flip
		has happened and the orientation thus has changed.

if FLIP_POLL
config FLIP_POLL_INTERVAL
	int "Flip detection poll interval"
	default 1000
	help
		Flip polling interval in milliseconds.
endif

config BATTERY_MONITOR
	bool "Use battery charge monitoring"
	help
	    Poll the current battery charge of the device and
	    act accordingly upon certain values.

if BATTERY_MONITOR
config BATTERY_MONITOR_THRESHOLD
	int "The lowest accepted battery level percentage"
	default 30
	help
	   Triggers an alarm if the battery level goes
	   below this value.

config BATTERY_MONITOR_INTERVAL
	int "Battery monitor poll interval"
	default 1000
	help
	    Battery monitor poll interval in milliseconds.

config BATTERY_MONITOR_RED_VALUE
	int "RED light intensity for low charge percentage"
	default 127
	help
	    The light intensity of the red LED if
	    the battery charge drops below a threshold value.
	    Range 0 - 255 (Lowest to highest)

config BATTERY_MONITOR_GREEN_VALUE
	int "GREEN light intensity for low charge percentage"
	default 127
	help
	    The light intensity of the green LED if
	    the battery charge is above a threshold value.
	    Range 0 - 255 (Lowest to highest)
endif

if ACCEL_USE_EXTERNAL

config ACCEL_DEV_NAME
	string "Accelerometer device name"
	help
		Device from which accelerometer data will be fetched and used
		for orientation detection and sent to nRF Cloud.

endif

config ACCEL_INVERTED
	bool "Accelerometer inverted"
	default y if BOARD_NRF9160_PCA20035NS
	help
		Enable if the accelerometer is mounted with the top side facing
		down when the board itself is in normal position.

config ACCEL_CALIBRATE
	bool "Calibrate accelerometer"
	help
		Calibrate the accelerometer on a flat surface to filter away
		static measurement offset that could affect orientation
		detection.

if ACCEL_CALIBRATE
config ACCEL_CALIBRATION_ITERATIONS
	int "Number of readings for calibration"
	default 20 if BOARD_NRF9160_PCA20035NS
	help
		Number of measurement readings to average over to find the
		static offset in the readings when calibrating the
		accelerometer.

config CALIBRATION_INPUT
	int "Button to trigger accelerometer calibration"
	range 1 2 if BOARD_NRF9160_PCA10090NS
	range 1 1 if BOARD_NRF9160_PCA20035NS
	default 1 if BOARD_NRF9160_PCA10090NS
	default 1 if BOARD_NRF9160_PCA20035NS
	help
		Button number to use to trigger accelerometer calibration:
		1 - Button 1
		2 - Button 2
endif

if !ACCEL_CALIBRATE
config ACCEL_CALIBRATION_ITERATIONS
	int
	default 0
endif

config ACCEL_ITERATIONS
	int "Number of readings per measurement"
	default 20 if BOARD_NRF9160_PCA20035NS
	default 1
	help
		Number of measurement readings to average over for each time
		the orientation detector determines the orientation of the
		board. Used for simple filtering of noisy measurements.

choice
	prompt "nRF Cloud user association"
	default CLOUD_UA_BUTTONS
	help
		Select which method to use for nRF Cloud user association
		input.

config CLOUD_UA_BUTTONS
	bool "Use buttons and switches"
	help
		Use buttons and switches on the development kit to provide
		user association input.

config CLOUD_UA_CONSOLE
	bool "Use console input"
	help
		Use console to enter nRF Cloud user association input.
		Allowed input is as follows:
		'b1' = Button 1
		'b2' = Button 2
		's1' = Switch 1
		's2' = Switch 2

endchoice


choice
	prompt "Temperature measurement device"
	default TEMP_USE_SIM
	help
		Select which device will provide temperature data.

config TEMP_USE_SIM
	bool "Use simulated temperature data"
	select SENSOR
	select SENSOR_SIM
	help
		Use sensor simulator to generate temperature data to send to
		nRF Cloud.

config TEMP_USE_EXTERNAL
	bool "User provided temperature device"
	help
		The user provides a temperature device that is
		used for temperature measurement.

endchoice

if TEMP_USE_SIM
config TEMP_DEV_NAME
	string
	default SENSOR_SIM_DEV_NAME

config TEMP_TRIGGER
	bool
	default SENSOR_SIM_TRIGGER

config TEMP_SIM_BUTTON
	int "Button or switch to trigger 'data ready' event"
	range 1 4 if BOARD_NRF9160_PCA10090NS
	range 1 1 if BOARD_NRF9160_PCA20035NS
	default 3 if BOARD_NRF9160_PCA10090NS
	default 1 if BOARD_NRF9160_PCA20035NS
	help
		Button or switch number to use for triggering
		a 'data ready' event.
		1 - Button 1
		2 - Button 2
		3 - Switch 1
		4 - Switch 2
endif

if TEMP_USE_EXTERNAL

config TEMP_DEV_NAME
	string "Temperature device name"
	help
		Device from which temperature data will be fetched and
		sent to nRF Cloud.

endif

if MODEM_INFO

config HOLD_TIME_RSRP
	int "Minimum time [s] between RSRP subscription messages"
	default 60
	help
		The minimum time in seconds where the modem
		informer is allowed to submit RSRP data to the cloud.

endif

endmenu

menu "Zephyr Kernel"
source "$ZEPHYR_BASE/Kconfig.zephyr"
endmenu
```

## prj.conf
```kconfig
#
# Copyright (c) 2019 Nordic Semiconductor ASA
#
# SPDX-License-Identifier: LicenseRef-BSD-5-Clause-Nordic
#
# General config
CONFIG_NEWLIB_LIBC=y
CONFIG_TEST_RANDOM_GENERATOR=y
CONFIG_ASSERT=y
CONFIG_REBOOT=y
CONFIG_LOG=y
CONFIG_LOG_IMMEDIATE=y

# Network
CONFIG_NETWORKING=y
CONFIG_NET_SOCKETS=y
CONFIG_NET_SOCKETS_OFFLOAD=y

# MQTT
CONFIG_MQTT_SOCKET_LIB=y
CONFIG_MQTT_LIB_TLS=y
CONFIG_MQTT_MAX_PACKET_LENGTH=2048

# LTE link control
CONFIG_POWER_OPTIMIZATION_ENABLE=n
CONFIG_LTE_LINK_CONTROL=y
CONFIG_LTE_AUTO_INIT_AND_CONNECT=n
CONFIG_LTE_LINK_CONTROL_LOG_LEVEL_DBG=y

CONFIG_LTE_NETWORK_MODE_NBIOT=n
CONFIG_LTE_LEGACY_PCO_MODE=n
CONFIG_LTE_PSM_REQ_RPTAU="00000110"
CONFIG_LTE_PSM_REQ_RAT="00000000"

# Modem info
CONFIG_MODEM_INFO=n

# BSD library
CONFIG_BSD_LIBRARY=y
CONFIG_BSD_LIBRARY_TRACE_ENABLED=n

# nRF Cloud
CONFIG_CLOUD_API=y
CONFIG_NRF_CLOUD=y
CONFIG_NRF_CLOUD_LOG_LEVEL_DBG=y
CONFIG_NRF_CLOUD_PROVISION_CERTIFICATES=y
# Sensors
CONFIG_ACCEL_USE_SIM=y
CONFIG_TEMP_USE_SIM=y
CONFIG_CLOUD_BUTTON=n
CONFIG_FLIP_INPUT=1
CONFIG_TEMP_SIM_BUTTON=1

# GPS
CONFIG_NRF9160_GPS=y
CONFIG_NRF9160_GPS_LOG_LEVEL_DBG=y
CONFIG_GPS_USE_EXTERNAL=y
CONFIG_GPS_DEV_NAME="NRF9160_GPS"

CONFIG_GPS_CONTROL=y
CONFIG_GPS_CONTROL_FIRST_FIX_CHECK_DELAY=10
CONFIG_GPS_CONTROL_FIX_CHECK_INTERVAL=30
CONFIG_GPS_CONTROL_FIX_TRY_TIME=360
CONFIG_GPS_CONTROL_PSM_DISABLE_ON_STOP=n

# Library for buttons and LEDs
CONFIG_DK_LIBRARY=y
CONFIG_DK_LIBRARY_INVERT_LEDS=n

# Console
CONFIG_CONSOLE_SUBSYS=y
CONFIG_CONSOLE_HANDLER=y
CONFIG_CONSOLE_GETCHAR=y

# Main thread
CONFIG_MAIN_THREAD_PRIORITY=7

# Heap and stacks
CONFIG_HEAP_MEM_POOL_SIZE=16384
CONFIG_MAIN_STACK_SIZE=8192
CONFIG_SYSTEM_WORKQUEUE_STACK_SIZE=2048
CONFIG_HW_STACK_PROTECTION=y

# Disable native network stack to save some memory
CONFIG_NET_IPV4=n
CONFIG_NET_IPV6=n
CONFIG_NET_UDP=n
CONFIG_NET_TCP=n
```

## prj_nrf9160_pca20035ns.conf
```kconfig
#
# Copyright (c) 2019 Nordic Semiconductor ASA
#
# SPDX-License-Identifier: LicenseRef-BSD-5-Clause-Nordic
#
# General config
CONFIG_NEWLIB_LIBC=y
CONFIG_NEWLIB_LIBC_FLOAT_PRINTF=y
CONFIG_ASSERT=y
CONFIG_REBOOT=y
CONFIG_LOG=y
CONFIG_LOG_IMMEDIATE=y

# Network
CONFIG_NETWORKING=y
CONFIG_NET_NATIVE=n
CONFIG_NET_SOCKETS=y
CONFIG_NET_SOCKETS_OFFLOAD=y

# LTE link control
CONFIG_POWER_OPTIMIZATION_ENABLE=n
CONFIG_LTE_LINK_CONTROL=y
CONFIG_LTE_NETWORK_MODE_LTE_M_GPS=y
CONFIG_LTE_AUTO_INIT_AND_CONNECT=n
CONFIG_LTE_LINK_CONTROL_LOG_LEVEL_DBG=y

CONFIG_LTE_NETWORK_MODE_NBIOT=n
CONFIG_LTE_LEGACY_PCO_MODE=n
CONFIG_LTE_PSM_REQ_RPTAU="00000110"
CONFIG_LTE_PSM_REQ_RAT="00000000"

CONFIG_LTE_LOCK_BANDS=y
# Enable band 2, 3, 4, 8, 12, 13 ,20 and 28
CONFIG_LTE_LOCK_BAND_MASK="1000000010000001100010001110"

# Modem info
CONFIG_MODEM_INFO=y

# BSD library
CONFIG_BSD_LIBRARY=y
CONFIG_BSD_LIBRARY_TRACE_ENABLED=n

# nRF Cloud
CONFIG_CLOUD_API=y
CONFIG_NRF_CLOUD=y
CONFIG_NRF_CLOUD_LOG_LEVEL_DBG=y
CONFIG_NRF_CLOUD_AGPS=y

# Sensors
CONFIG_SENSOR=y
CONFIG_ACCEL_USE_EXTERNAL=y
CONFIG_ACCEL_DEV_NAME="ADXL362"
CONFIG_ADXL362=y
CONFIG_ADXL362_TRIGGER_GLOBAL_THREAD=y
CONFIG_ADXL362_ABS_REF_MODE=1
CONFIG_ADXL362_ACTIVITY_THRESHOLD=200
CONFIG_ADXL362_INACTIVITY_THRESHOLD=200
CONFIG_ADXL362_INTERRUPT_MODE=1
CONFIG_TEMP_USE_EXTERNAL=y
CONFIG_TEMP_DEV_NAME="BME680"

# Deselect CONFIG_BME680 if CONFIG_USE_BME680_BSEC is selected
CONFIG_BME680=y
CONFIG_USE_BME680_BSEC=n

# GPS
CONFIG_NRF9160_GPS_LOG_LEVEL_DBG=y
CONFIG_NRF9160_GPS=y
CONFIG_NRF9160_GPS_LOG_LEVEL_DBG=y
CONFIG_GPS_USE_EXTERNAL=y
CONFIG_GPS_DEV_NAME="NRF9160_GPS"
CONFIG_GPS_CONTROL_PSM_ENABLE_ON_START=y

CONFIG_GPS_CONTROL_FIRST_FIX_CHECK_DELAY=10
CONFIG_GPS_CONTROL_FIX_CHECK_INTERVAL=30
CONFIG_GPS_CONTROL_FIX_TRY_TIME=120
CONFIG_GPS_CONTROL_PSM_DISABLE_ON_STOP=n

# Library for buttons and LEDs
CONFIG_DK_LIBRARY=y
CONFIG_DK_LIBRARY_INVERT_LEDS=n

# Console
CONFIG_CONSOLE_SUBSYS=y
CONFIG_CONSOLE_HANDLER=y
CONFIG_CONSOLE_GETCHAR=y

# Heap and stacks
CONFIG_HEAP_MEM_POOL_SIZE=16384
CONFIG_MAIN_STACK_SIZE=8192
CONFIG_SYSTEM_WORKQUEUE_STACK_SIZE=2048
CONFIG_HW_STACK_PROTECTION=y

# Settings
CONFIG_FLASH=y
CONFIG_FLASH_PAGE_LAYOUT=y
CONFIG_FLASH_MAP=y
CONFIG_FCB=y
CONFIG_SETTINGS=y
CONFIG_SETTINGS_FCB=y
CONFIG_MPU_ALLOW_FLASH_WRITE=y

# MCUBOOT
CONFIG_BOOTLOADER_MCUBOOT=y
CONFIG_IMG_MANAGER=y
CONFIG_MCUBOOT_IMG_MANAGER=y
CONFIG_IMG_ERASE_PROGRESSIVELY=y

# AWS FOTA
CONFIG_AWS_FOTA=y
CONFIG_FOTA_DOWNLOAD=y
CONFIG_AWS_FOTA_LOG_LEVEL_DBG=y
CONFIG_AWS_JOBS_LOG_LEVEL_DBG=y
CONFIG_DFU_TARGET=y

# Download client (needed by AWS FOTA)
CONFIG_DOWNLOAD_CLIENT=y
CONFIG_DOWNLOAD_CLIENT_STACK_SIZE=4096

# Fatal error
CONFIG_RESET_ON_FATAL_ERROR=n

CONFIG_WATCHDOG=n

CONFIG_MQTT_KEEPALIVE=120
```

## prj_thingy91_nrf9160ns.conf
```kconfig
#
# Copyright (c) 2019 Nordic Semiconductor ASA
#
# SPDX-License-Identifier: LicenseRef-Nordic-5-Clause
#
# General config
CONFIG_NEWLIB_LIBC=y
CONFIG_NEWLIB_LIBC_FLOAT_PRINTF=y
CONFIG_ASSERT=y
CONFIG_REBOOT=y
CONFIG_LOG=y
CONFIG_LOG_MODE_IMMEDIATE=y

# Network
CONFIG_NETWORKING=y
CONFIG_NET_NATIVE=n
CONFIG_NET_SOCKETS=y
CONFIG_NET_SOCKETS_OFFLOAD=y

# LTE link control
CONFIG_POWER_OPTIMIZATION_ENABLE=n
CONFIG_LTE_LINK_CONTROL=y
CONFIG_LTE_NETWORK_MODE_LTE_M_GPS=y
CONFIG_LTE_AUTO_INIT_AND_CONNECT=n

CONFIG_LTE_NETWORK_MODE_NBIOT=n
CONFIG_LTE_PSM_REQ_RPTAU="00000110"
CONFIG_LTE_PSM_REQ_RAT="00000010"

CONFIG_LTE_LOCK_BANDS=y
# Enable band 2, 3, 4, 8, 12, 13 ,20 and 28
CONFIG_LTE_LOCK_BAND_MASK="1000000010000001100010001110"

# Modem info
CONFIG_MODEM_INFO=y
CONFIG_MODEM_INFO_ADD_DATE_TIME=n

# Modem library
CONFIG_NRF_MODEM_LIB=y
CONFIG_NRF_MODEM_LIB_TRACE_ENABLED=n

# nRF Cloud
CONFIG_CLOUD_API=y
CONFIG_NRF_CLOUD=y
CONFIG_NRF_CLOUD_LOG_LEVEL_DBG=y
CONFIG_NRF_CLOUD_PGPS=y
CONFIG_PGPS_STORE_LOCATION=n
CONFIG_NRF_CLOUD_AGPS=y
CONFIG_NRF_CLOUD_GPS_LOG_LEVEL_DBG=y
CONFIG_NRF_CLOUD_PGPS_NUM_PREDICTIONS=42
CONFIG_NRF_CLOUD_CONNECTION_POLL_THREAD=y
CONFIG_NRF_CLOUD_SEND_TIMEOUT=y
CONFIG_NRF_CLOUD_SEND_TIMEOUT_SEC=60
CONFIG_NRF_CLOUD_FOTA_LOG_LEVEL_DBG=y
# nRF Cloud FOTA download configuration
CONFIG_DOWNLOAD_CLIENT_STACK_SIZE=4096
# Needed for the cloud codec
CONFIG_CJSON_LIB=y
# Shorter to prevent NAT timeouts
CONFIG_MQTT_KEEPALIVE=120
# Don't resubscribe to topics if broker remembers them
CONFIG_MQTT_CLEAN_SESSION=n

# Sensors
CONFIG_SENSOR=y
CONFIG_ACCEL_USE_EXTERNAL=y
CONFIG_ACCEL_DEV_NAME="ADXL362"
CONFIG_ADXL362=y
CONFIG_ADXL362_TRIGGER_GLOBAL_THREAD=y
CONFIG_ADXL362_ABS_REF_MODE=1
CONFIG_ADXL362_ACTIVITY_THRESHOLD=200
CONFIG_ADXL362_INACTIVITY_THRESHOLD=200
CONFIG_ADXL362_INTERRUPT_MODE=1
CONFIG_TEMP_USE_EXTERNAL=y
CONFIG_TEMP_DEV_NAME="BME680"

# Deselect CONFIG_BME680 if CONFIG_USE_BME680_BSEC is selected
CONFIG_BME680=y
CONFIG_USE_BME680_BSEC=n

# Enable FPU to support the BME680_BSEC library when enabled
CONFIG_FPU=y

# GPS
CONFIG_NRF9160_GPS_LOG_LEVEL_DBG=y
CONFIG_NRF9160_GPS=y
CONFIG_NRF9160_GPS_LOG_LEVEL_DBG=y
CONFIG_GPS_USE_EXTERNAL=y
CONFIG_GPS_DEV_NAME="NRF9160_GPS"
CONFIG_GPS_CONTROL_PSM_ENABLE_ON_START=y

CONFIG_GPS_CONTROL_FIRST_FIX_CHECK_DELAY=10
CONFIG_GPS_CONTROL_FIX_CHECK_INTERVAL=30
CONFIG_GPS_CONTROL_FIX_TRY_TIME=360
CONFIG_GPS_CONTROL_PSM_DISABLE_ON_STOP=n
CONFIG_GPS_START_ON_MOTION=y
CONFIG_AGPS=y

# Library for buttons and LEDs
CONFIG_DK_LIBRARY=y
CONFIG_DK_LIBRARY_INVERT_LEDS=n

# Library that maintains the current date time UTC.
CONFIG_DATE_TIME=y

# Console
CONFIG_CONSOLE_SUBSYS=y
CONFIG_CONSOLE_HANDLER=y
CONFIG_CONSOLE_GETCHAR=y

# Heap and stacks
CONFIG_HEAP_MEM_POOL_SIZE=16384
CONFIG_MAIN_STACK_SIZE=8192
CONFIG_SYSTEM_WORKQUEUE_STACK_SIZE=2048

# Settings
CONFIG_FLASH=y
CONFIG_FLASH_PAGE_LAYOUT=y
CONFIG_FLASH_MAP=y
CONFIG_FCB=y
CONFIG_SETTINGS=y
CONFIG_SETTINGS_FCB=y
CONFIG_MPU_ALLOW_FLASH_WRITE=y

# MCUBOOT
CONFIG_BOOTLOADER_MCUBOOT=y
CONFIG_IMG_MANAGER=y
CONFIG_MCUBOOT_IMG_MANAGER=y
CONFIG_IMG_ERASE_PROGRESSIVELY=y

# Fatal error
CONFIG_RESET_ON_FATAL_ERROR=n
CONFIG_WATCHDOG=y
```

## spm.conf
```kconfig
# Configuration copied from the nRF Secure Partition Manager (SPM) sample:
CONFIG_IS_SPM=y
CONFIG_FW_INFO=y
CONFIG_GPIO=n

# Make watchdog timers non-secure (so they can be used in the non-secure image).
CONFIG_SPM_NRF_WDT_NS=y
CONFIG_SPM_BOOT_SILENTLY=y
CONFIG_SERIAL=n
```

## src/certificates.h
```c
/*
 * Copyright (c) 2018 Nordic Semiconductor ASA
 *
 * SPDX-License-Identifier: LicenseRef-BSD-5-Clause-Nordic
 */

#define NRF_CLOUD_CLIENT_ID "nrf-352656100000499"

#define NRF_CLOUD_CLIENT_PRIVATE_KEY \
	"-----BEGIN RSA PRIVATE KEY-----\nMIIEpQIBAAKCAQEA6X+/tOvUVIu49xoHZ0ehSgx6qdU9CcObJmTPqtxcoLj5lAhg\nt00rs7Ryt0+QM9h8p+RYH/NCoaconOJ8dI1xPEDhX14CK8MNfoa92uYMPVrAhV/v\ngHKiAw/9PL7XV70xZu+SgQ5N/q5/jRYvhEF9SdXJhvVxZrjgOoT/lDzgTXdkK+ku\nfTWaOHE1KRH6XFAcNmEHbeF12EriF8Eh384zoknrOuck0vVXWQoSlB1WaOzisSx5\nA+6NKojVUDXQMKHJsCgXnseSaFtuoYipwa3dp80rW3wYfYu8SAuFR1GGJiOAl34j\n1jCPVS+Y8xzS+DWqZ78JokaSeB0rkUky5MLc+wIDAQABAoIBAQDaiPbKhIGoU1Dc\n7B6Lug2peT6AnxPOhKU77NQzzKRgxF7J/oFObUp+mV9YU33aGD6q/9q+pHTzSLiJ\nBKyIhSy6wNpt4FVV0etaRQ+BxRclgT94VM6aQC+DgD550P9InciT15sdcF7tAzJb\nwKzeMlDpfs5romHtSxCJlJqDiepAdLidP9EKKApGj595U4s5YqBi9ygtFB1ysRSV\n/AaNGru/JA20LahOytv6rUpX12r6JK09EdPIicSYJ0Wvg0lK7Z4zILhJbP271nkj\nOzoFe6XiMsSGKUgBtsmx0uffPxx26XVYj077WvXafCvRgVLJhxrYB/ikdj3gGqCu\n/z16+7TxAoGBAPrioT4fGltVy2pAVStwQ2hW2ZAKXvoLohXtgXg2qrodRYyMWWmp\npBr3rEud/aY/mLLp412iAK+1s+IbrloNVEEXjMd8Fie7FPr3e6dFMmBEszMcWKFW\nYb6wsxioNhLOBsupQVBGuEk0LoPabUiHUn9DkIft8ePlnOUYPkPS97F5AoGBAO5C\nYVFZ5ASW2rTH0//BFRamFsS8/Nc3TGZZJlbBJxPCAwbN7PFfCS2zBu+Jh70CgtR0\noUwN5PIFNS/g7kfOH3j1Xd/+JKJar5Yk5Zv5VJ+EC64kvr7yx/7VF53uxjEyGUZh\n+Yg8TS0CjIThidsFwy0DxiD9j/en5bii+L44UvkTAoGBAIazdWU4J9uQFdYnUlMv\nRFHaB5fJqbLQ2iaxzUiw+TtSCgxrMnqDxYNhJRW4bv56uM6eux+DoqC0iy9EM3lQ\nHMOSFFjqq66LSLlydOabRW/gkuJHPuLo0TQkBRShA99W1Nk2N8YVIk7TgIH0naZK\nWaXQreH9hFka6AEs4gliVPDpAoGBAIg0KGASLDi3aHW6WqY1YfHdptx3UW9S7HkB\n89nad5Vi7soABLkDZELculVLYO6bNeFwfxj0RHJaqcoiIvWnjvReCHlZVuX9Q61o\nkF43DbpXCTpXRTfxoIU8mlCtxF0xT6OdtMG9/zyA3YXFTUKJK8dbBfOsIJYqRDfl\n6p8LodtDAoGAGq7kDm17u59URKpUK7UTGAH57UxM0Ifks6kccwzgKkyE1vipwd9u\nUzRDF5V8KKp7TZ9pbxERRDkDlF1Rquk+lcLkFTx4et20rIqfjp7GUr3aZVrUawJh\nUPp7mJvQCmTbMHhNi2aX8/ny+3mC+LIwXc6KG+vU3ewifshZ6eY07V4=\n-----END RSA PRIVATE KEY-----\n"
  

#define NRF_CLOUD_CLIENT_PUBLIC_CERTIFICATE \
	"-----BEGIN CERTIFICATE-----\nMIICqTCCAZECCQCHZ66cq+VC8TANBgkqhkiG9w0BAQsFADATMREwDwYDVQQLDAhi\naWZyYXZzdDAeFw0xOTA4MjYyMDI4NDhaFw00OTA4MTgyMDI4NDhaMBoxGDAWBgNV\nBAMMDzM1MjY1NjEwMDMxODc2ODCCASIwDQYJKoZIhvcNAQEBBQADggEPADCCAQoC\nggEBAOl/v7Tr1FSLuPcaB2dHoUoMeqnVPQnDmyZkz6rcXKC4+ZQIYLdNK7O0crdP\nkDPYfKfkWB/zQqGnKJzifHSNcTxA4V9eAivDDX6GvdrmDD1awIVf74ByogMP/Ty+\n11e9MWbvkoEOTf6uf40WL4RBfUnVyYb1cWa44DqE/5Q84E13ZCvpLn01mjhxNSkR\n+lxQHDZhB23hddhK4hfBId/OM6JJ6zrnJNL1V1kKEpQdVmjs4rEseQPujSqI1VA1\n0DChybAoF57HkmhbbqGIqcGt3afNK1t8GH2LvEgLhUdRhiYjgJd+I9Ywj1UvmPMc\n0vg1qme/CaJGkngdK5FJMuTC3PsCAwEAATANBgkqhkiG9w0BAQsFAAOCAQEAEzXG\nH4q1G/zyuYJMroVLMnaye/hLkzds2SEpg8UCBzrgVXZxOHSM5+eSGHVarYN96w3N\nQNfMdpCw2NbQffS46gMf0HIga6yJpcX3jRIunJGkfQ/e4T5A+fCo+ATe9gAbfkMx\nPdu7HKp/nMGgrqhWsZcuQcW6ffD/D8BV/+2TcKmgiG79nHZBH8d65Nm8W5ZTXgva\nUBnNTXHxeymEKPRMTDHL/HBeEKDH60Bemp0sTe1rGWpDcuSd6Wq5PLDVbfxvwbT7\nA9hxmJoUNUbDS/pw+r8lq/CslyYVxy3bklJJayXtzasQyh7vAH0JdoXdwRK6hv9A\nb4i7xBaBP5PCEQv4Xg==\n-----END CERTIFICATE-----\n\n-----BEGIN CERTIFICATE-----\nMIIC+TCCAeGgAwIBAgIJAKb6UHpZEoRVMA0GCSqGSIb3DQEBCwUAMBMxETAPBgNV\nBAsMCGJpZnJhdnN0MB4XDTE5MDgyNDIxNTE1MFoXDTIwMDgyMzIxNTE1MFowEzER\nMA8GA1UECwwIYmlmcmF2c3QwggEiMA0GCSqGSIb3DQEBAQUAA4IBDwAwggEKAoIB\nAQDFNMZBXFUr12XFJxlFF1fH9sQBbsXod54pPYrcUckzchUsB9mk/CWaI+fA8NSy\nNbv8kbCfUK/c2hiVBtziz7DknloTGBwaAP/ZX1dzgD2KH1LblEGNDbZkpCKU9/Pj\nB///r7mMCBvkXHx/H3ri3CvbNUM8HZ4xeQ2ZlrtvXGwuh+gbeG+kgqPcv/Cewm8V\n+2PEm9fXvnySqWcrxyv1Gyg45F4I4fh63w0OalWp/ql41mdbD4GwyH27uo00sfd6\njLixHrzous6j1Wrvn7G1D+BV4ivcKs9uzVazo0PjgkT1xVk06Y3YpkCuAn0bSObL\nzDWaf+mUpvRLcmzfvs9b3Rk5AgMBAAGjUDBOMB0GA1UdDgQWBBQ3NjaUelNq7HxY\nFLS3tSs4O8Q79DAfBgNVHSMEGDAWgBQ3NjaUelNq7HxYFLS3tSs4O8Q79DAMBgNV\nHRMEBTADAQH/MA0GCSqGSIb3DQEBCwUAA4IBAQBIAFicdsHDyT8eltyk8OcIRNHr\nRCHtrP5BhNi7xbWLR7Qvue+8Na71vlQS/AfLuDEjj+edE9hyQ4FL8Z02TrZtoLtf\nGLRAmzVyYar3rm81mwpWwfODY9x6Q5jY+Wyauuf2/2quSxNrVOOarsM1GH4+Qkz+\nE/qVdx4ee38Bu9EgIooAGAzf23qDZTCvyoWdvovnmaWhYOsHi8cm/PSvvdVkXoAJ\nVZYHQhhuIsnpAoWqdQEjqKQ9+556RhsjAF/O4eBQfNtQhlxJo+l5gRtcYUBKVXv3\nBlxi0Ez1pcMjbspQ0B6xPMszxZGxMihjkjZNvd91T1phiqif18L2UPitEVaE\n-----END CERTIFICATE-----\n"
  

#define NRF_CLOUD_CA_CERTIFICATE \
	"-----BEGIN CERTIFICATE-----\nMIIDQTCCAimgAwIBAgITBmyfz5m/jAo54vB4ikPmljZbyjANBgkqhkiG9w0BAQsF\nADA5MQswCQYDVQQGEwJVUzEPMA0GA1UEChMGQW1hem9uMRkwFwYDVQQDExBBbWF6\nb24gUm9vdCBDQSAxMB4XDTE1MDUyNjAwMDAwMFoXDTM4MDExNzAwMDAwMFowOTEL\nMAkGA1UEBhMCVVMxDzANBgNVBAoTBkFtYXpvbjEZMBcGA1UEAxMQQW1hem9uIFJv\nb3QgQ0EgMTCCASIwDQYJKoZIhvcNAQEBBQADggEPADCCAQoCggEBALJ4gHHKeNXj\nca9HgFB0fW7Y14h29Jlo91ghYPl0hAEvrAIthtOgQ3pOsqTQNroBvo3bSMgHFzZM\n9O6II8c+6zf1tRn4SWiw3te5djgdYZ6k/oI2peVKVuRF4fn9tBb6dNqcmzU5L/qw\nIFAGbHrQgLKm+a/sRxmPUDgH3KKHOVj4utWp+UhnMJbulHheb4mjUcAwhmahRWa6\nVOujw5H5SNz/0egwLX0tdHA114gk957EWW67c4cX8jJGKLhD+rcdqsq08p8kDi1L\n93FcXmn/6pUCyziKrlA4b9v7LWIbxcceVOF34GfID5yHI9Y/QCB/IIDEgEw+OyQm\njgSubJrIqg0CAwEAAaNCMEAwDwYDVR0TAQH/BAUwAwEB/zAOBgNVHQ8BAf8EBAMC\nAYYwHQYDVR0OBBYEFIQYzIU07LwMlJQuCFmcx7IQTgoIMA0GCSqGSIb3DQEBCwUA\nA4IBAQCY8jdaQZChGsV2USggNiMOruYou6r4lK5IpDB/G/wkjUu0yKGX9rbxenDI\nU5PMCCjjmCXPI6T53iHTfIUJrU6adTrCC2qJeHZERxhlbI1Bjjt/msv0tadQ1wUs\nN+gDS63pYaACbvXy8MWy7Vu33PqUXHeeE6V/Uq2V8viTO96LXFvKWlJbYK8U90vv\no/ufQJVtMVT8QtPHRh8jrdkPSHCa2XV4cdFyQzR1bldZwgJcJmApzyMZFo6IQ6XU\n5MsI+yMRQ+hDKXJioaldXgjUkK642M4UwtBV8ob2xJNDd2ZhwLnoQdeXeGADbkpy\nrqXRfboQnoZsG4q5WTP468SQvvG5\n-----END CERTIFICATE-----\n"
```
