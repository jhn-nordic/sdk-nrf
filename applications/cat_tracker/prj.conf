## prj.conf
```kconfig
# General config
CONFIG_TEST_RANDOM_GENERATOR=y
CONFIG_ASSERT=n
CONFIG_REBOOT=y
CONFIG_NEWLIB_LIBC=y
CONFIG_DEBUG=n

# BSD library
CONFIG_DK_LIBRARY=y
CONFIG_DK_LIBRARY_INVERT_LEDS=y

# Disable native network stack to save some memory
CONFIG_NET_IPV4=n
CONFIG_NET_IPV6=n
CONFIG_NET_UDP=n
CONFIG_NET_TCP=n
CONFIG_NET_RX_STACK_SIZE=256
CONFIG_NET_TX_STACK_SIZE=256

# MQTT
CONFIG_MQTT_LIB=y
CONFIG_MQTT_LIB_TLS=y
CONFIG_MQTT_KEEPALIVE=10

# JSON LIB
CONFIG_CJSON_LIB=y

# GPS, STACK
CONFIG_BSD_LIBRARY=y
CONFIG_NETWORKING=y
CONFIG_NET_SOCKETS_OFFLOAD=y
CONFIG_NET_SOCKETS=y
CONFIG_MAIN_STACK_SIZE=8192
CONFIG_HEAP_MEM_POOL_SIZE=16348
CONFIG_SYSTEM_WORKQUEUE_STACK_SIZE=8192
CONFIG_NET_SOCKETS_POSIX_NAMES=y
CONFIG_HW_STACK_PROTECTION=y

# LTE link control
CONFIG_LTE_LINK_CONTROL=y
CONFIG_LTE_AUTO_INIT_AND_CONNECT=n
# CONFIG_LTE_NETWORK_MODE_NBIOT=n
# CONFIG_LTE_LEGACY_PCO_MODE=n
CONFIG_LTE_PSM_REQ_RPTAU="00000110"
#CONFIG_LTE_NETWORK_MODE_NBIOT=n
#CONFIG_LTE_LEGACY_PCO_MODE=n
#CONFIG_LTE_PSM_REQ_RPTAU="00000011"
CONFIG_LTE_PSM_REQ_RAT="00000000"

# CONFIG_LTE_LOCK_BANDS=y
# # Enable band 2, 3, 4, 8, 12, 13 ,20 and 28
# CONFIG_LTE_LOCK_BAND_MASK="1000000010000001100010001110"

# LOG
CONFIG_LOG=n
CONFIG_LOG_DEFAULT_LEVEL=2
CONFIG_LOG_BACKEND_UART=n
CONFIG_LOG_STRDUP_BUF_COUNT=10
# CONFIG_MQTT_LOG_LEVEL_DBG=n
# CONFIG_NET_LOG=n
# AT Host
CONFIG_UART_INTERRUPT_DRIVEN=n
CONFIG_AT_HOST_LIBRARY=n

# # ADXL362
# CONFIG_ADXL362=y
# CONFIG_HAS_DTS_I2C=y
# CONFIG_SPI=y
# CONFIG_SENSOR=y
# CONFIG_ADXL362_TRIGGER_GLOBAL_THREAD=y
# CONFIG_ADXL362_INTERRUPT_MODE=1
# CONFIG_ADXL362_ABS_REF_MODE=1
# CONFIG_ADXL362_ACTIVITY_THRESHOLD=400
# CONFIG_ADXL362_INACTIVITY_THRESHOLD=300

# I2C
CONFIG_I2C=y
CONFIG_I2C_NRFX=y
CONFIG_I2C_2=y
CONFIG_I2C_2_NRF_TWIM=y

# Accelerometer (LIS2DH)
CONFIG_SENSOR=y
CONFIG_SENSOR_LOG_LEVEL_OFF=y
CONFIG_LIS2DH=y
CONFIG_LIS2DH_TRIGGER=y
CONFIG_LIS2DH_TRIGGER_GLOBAL_THREAD=y
CONFIG_LIS2DH_ACCEL_RANGE_8G=y
CONFIG_LIS2DH_ODR_1=y

# GPS
CONFIG_NRF9160_GPS_LOG_LEVEL_DBG=y
CONFIG_GPS_CONTROL=y
CONFIG_GPS_USE_EXTERNAL=y
CONFIG_GPS_DEV_NAME="NRF9160_GPS"
CONFIG_GPS_CONTROL_FIRST_FIX_CHECK_DELAY=10
CONFIG_GPS_CONTROL_FIX_CHECK_INTERVAL=30
CONFIG_GPS_CONTROL_FIX_TRY_TIME=180
CONFIG_GPS_CONTROL_FIX_COUNT=3

# MODEM INFO
CONFIG_MODEM_INFO=y

CONFIG_CLOUD_HOST_NAME="a343bol57zw6mo-ats.iot.eu-west-1.amazonaws.com"
CONFIG_CLOUD_CERT_SEC_TAG=16842753


CONFIG_WATCHDOG=y
```

## src/main.c
```c
#include <zephyr.h>
#include <stdio.h>
#include <uart.h>
#include <string.h>
#include <logging/log.h>
#include <logging/log_ctrl.h>
#include <misc/reboot.h>
#include <mqtt_behaviour.h>
#include <modem_data.h>
#include <device.h>
#include <sensor.h>
#include <gps_controller.h>
#include <mqtt_codec.h>
#include <leds.h>
#include <gpio.h>
#include <drivers/watchdog.h>

#define NORMAL_OPERATION false
#define SYNCRONIZATION true
#define NO_GPS_FIX false
#define GPS_FIX true
#define INCLUDE_MOD_D true

#define AT_CMD_SIZE(x) (sizeof(x) - 1)

#define LTE_CONN_TIMEOUT 10

static bool active;
static bool lte_connected = false;

static struct k_sem connect_sem;

K_SEM_DEFINE(gps_timeout_sem, 0, 1);
K_SEM_DEFINE(accel_trig_sem, 0, 1);

struct k_poll_event events[2] = {
	K_POLL_EVENT_STATIC_INITIALIZER(K_POLL_TYPE_SEM_AVAILABLE,
					K_POLL_MODE_NOTIFY_ONLY,
					&gps_timeout_sem, 0),
	K_POLL_EVENT_STATIC_INITIALIZER(K_POLL_TYPE_SEM_AVAILABLE,
					K_POLL_MODE_NOTIFY_ONLY,
					&accel_trig_sem, 0)
};

enum error_type {
	ERROR_BSD_RECOVERABLE,
	ERROR_BSD_IRRECOVERABLE,
	ERROR_SYSTEM_FAULT
};

void error_handler(enum error_type err_type, int err_code)
{
#if !defined(CONFIG_DEBUG) && defined(CONFIG_REBOOT)
	LOG_PANIC();
	sys_reboot(0);
#else
	switch (err_type) {
	case ERROR_BSD_RECOVERABLE:
		printk("Error of type ERROR_BSD_RECOVERABLE: %d\n", err_code);
		break;
	case ERROR_BSD_IRRECOVERABLE:
		printk("Error of type ERROR_BSD_IRRECOVERABLE: %d\n", err_code);
		break;

	case ERROR_SYSTEM_FAULT:
		printk("Error of type ERROR_SYSTEM_FAULT: %d\n", err_code);
		break;
	default:
		printk("Unknown error type: %d, code: %d\n", err_type,
		       err_code);
		break;
	}

	while (true) {
		k_cpu_idle();
	}
#endif
}

void k_sys_fatal_error_handler(unsigned int reason, const z_arch_esf_t *esf)
{
	ARG_UNUSED(esf);

	LOG_PANIC();
	z_fatal_print("Running main.c error handler");
	error_handler(ERROR_SYSTEM_FAULT, reason);
	CODE_UNREACHABLE;
}

struct wdt_data_storage {
	struct device *wdt_drv;
	int wdt_channel_id;
};
static struct wdt_data_storage wdt_data;
static int watchdog_enable(struct wdt_data_storage *data)
{
	__ASSERT_NO_MSG(data != NULL);

	int err = -ENXIO;

	data->wdt_drv = device_get_binding(DT_WDT_0_NAME);
	if (data->wdt_drv == NULL) {
		return err;
	}

	static const struct wdt_timeout_cfg wdt_settings = {
			.window = {
				.min = 0,
				.max = 10000
			},
			.callback = NULL,
			.flags = WDT_FLAG_RESET_SOC
	};


	data->wdt_channel_id = wdt_install_timeout(
			data->wdt_drv, &wdt_settings);
	if (data->wdt_channel_id < 0) {
		return -EFAULT;
	}

	err = wdt_setup(data->wdt_drv, WDT_OPT_PAUSE_HALTED_BY_DBG);

	
	return err;
}
static void cloud_publish(bool gps_fix, bool action, bool inc_modem_d)
{
	int err;

	if (lte_connected) {
		set_led_state(PUBLISH_DATA_E);
		attach_battery_data(request_battery_status());

		set_gps_found(gps_fix);

		err = publish_data(action, inc_modem_d);
		if (err != 0) {
			printk("Error publishing data: %d", err);
		}
		set_led_state(PUBLISH_DATA_STOP_E);

	} else {
		printk("Publish of data denied, LTE not connected\n");
	}
}

static struct k_work cloud_get_work;

static void cloud_get_work_fn(struct k_work *work)
{
	cloud_publish(NO_GPS_FIX, SYNCRONIZATION, INCLUDE_MOD_D);
}

static void work_init(void)
{
	k_work_init(&cloud_get_work, cloud_get_work_fn);
}

static const char status1[] = "+CEREG: 1";
static const char status2[] = "+CEREG:1";
static const char status3[] = "+CEREG: 5";
static const char status4[] = "+CEREG:5";

void connection_handler(char *response)
{
	int err;

	printk("recv: %s", response);

	if (!memcmp(status1, response, AT_CMD_SIZE(status1)) ||
	    !memcmp(status2, response, AT_CMD_SIZE(status2)) ||
	    !memcmp(status3, response, AT_CMD_SIZE(status3)) ||
	    !memcmp(status4, response, AT_CMD_SIZE(status4))) {
		if (!lte_connected) {
			printk("CONNECTED\n");

			k_sleep(5000);

			err = modem_time_get();
			if (err != 0) {
				printk("Error fetching modem time\n");
			}

			lte_connected = true;
			k_sem_give(&connect_sem);
		}

	} else {
		printk("Disconnected\n");

		lte_connected = false;
	}
}

static void adxl362_trigger_handler(struct device *dev,
				    struct sensor_trigger *trig)
{
	static struct sensor_value accel[3];

	switch (trig->type) {
	case SENSOR_TRIG_THRESHOLD:

		if (sensor_sample_fetch(dev) < 0) {
			printk("Sample fetch error\n");
			return;
		}

		sensor_channel_get(dev, SENSOR_CHAN_ACCEL_X, &accel[0]);
		sensor_channel_get(dev, SENSOR_CHAN_ACCEL_Y, &accel[1]);
		sensor_channel_get(dev, SENSOR_CHAN_ACCEL_Z, &accel[2]);

		if ((abs(sensor_value_to_double(&accel[0])) >
		     check_accel_thres()) ||
		    (abs(sensor_value_to_double(&accel[1])) >
		     check_accel_thres()) ||
		    (abs(sensor_value_to_double(&accel[2])) >
		     check_accel_thres())) {
			attach_accel_data(sensor_value_to_double(&accel[0]),
					  sensor_value_to_double(&accel[1]),
					  sensor_value_to_double(&accel[2]));
			k_sem_give(events[1].sem);
		}

		break;
	default:
		printk("Unknown trigger\n");
	}
}
static void lis2dh_trigger_handler(struct device *dev,
				    struct sensor_trigger *trig)
{
	static struct sensor_value accel[3];

	switch (trig->type) {
	case SENSOR_TRIG_DATA_READY:

		if (sensor_sample_fetch(dev) < 0) {
			printk("Sample fetch error\n");
			return;
		}

		sensor_channel_get(dev, SENSOR_CHAN_ACCEL_X, &accel[0]);
		sensor_channel_get(dev, SENSOR_CHAN_ACCEL_Y, &accel[1]);
		sensor_channel_get(dev, SENSOR_CHAN_ACCEL_Z, &accel[2]);
		wdt_feed(wdt_data.wdt_drv, wdt_data.wdt_channel_id);
		if ((abs(sensor_value_to_double(&accel[0])) >
		     check_accel_thres()) ||
		    (abs(sensor_value_to_double(&accel[1])) >
		     check_accel_thres()) ||
		    (abs(sensor_value_to_double(&accel[2])) >
		     check_accel_thres())) {
			attach_accel_data(sensor_value_to_double(&accel[0]),
					  sensor_value_to_double(&accel[1]),
					  sensor_value_to_double(&accel[2]));
			k_sem_give(events[1].sem);
		}

		break;
	default:
		printk("Unknown trigger\n");
	}
}

static void gps_control_handler(struct device *dev, struct gps_trigger *trigger)
{
	static struct gps_data gps_data;

	switch (trigger->type) {
	case GPS_TRIG_FIX:
		printk("gps control handler triggered!\n");
		gps_control_on_trigger();
		gps_channel_get(dev, GPS_CHAN_PVT, &gps_data);
		set_current_time(gps_data);
		attach_gps_data(gps_data);
		k_sem_give(events[0].sem);
		break;

	default:
		break;
	}
}
/* 
static void adxl362_init(void)
{
	struct device *dev = device_get_binding(DT_INST_0_ADI_ADXL362_LABEL);

	if (dev == NULL) {
		printk("Device get binding device\n");
		return;
	}

	if (IS_ENABLED(CONFIG_ADXL362_TRIGGER)) {
		struct sensor_trigger trig = { .chan = SENSOR_CHAN_ACCEL_XYZ };

		trig.type = SENSOR_TRIG_THRESHOLD;
		if (sensor_trigger_set(dev, &trig, adxl362_trigger_handler)) {
			printk("Trigger set error\n");
			return;
		}
	}
}*/


static void lis2dh_init(void)
{
	struct device *dev = device_get_binding("LIS2DH12-ACCEL");

	if (dev == NULL) {
		printk("Device get binding device\n");
		return;
	}

	if (IS_ENABLED(CONFIG_LIS2DH_TRIGGER)) {
		struct sensor_trigger trig = { .chan = SENSOR_CHAN_ACCEL_XYZ };

		trig.type = SENSOR_TRIG_DATA_READY;
		if (sensor_trigger_set(dev, &trig, lis2dh_trigger_handler)) {
			printk("Trigger set error\n");
			return;
		}
	}
}

void movement_timeout_handler(struct k_work *work)
{
	cloud_publish(NO_GPS_FIX, NORMAL_OPERATION, INCLUDE_MOD_D);
}

K_WORK_DEFINE(my_work, movement_timeout_handler);

void movement_timer_handler(struct k_timer *dummy)
{
	k_work_submit(&my_work);
}

K_TIMER_DEFINE(mov_timer, movement_timer_handler, NULL);

static void start_restart_mov_timer(void)
{
	k_timer_start(&mov_timer, K_SECONDS(check_mov_timeout()),
		      K_SECONDS(check_mov_timeout()));
}

static void lte_connect()
{
	int err;

	set_led_state(LTE_CONNECTING_E);

	k_sem_init(&connect_sem, 0, 1);
	err = lte_lc_init_connect_manager(connection_handler);
	if (err != 0) {
		printk("Error setting lte_connect manager: %d\n", err);
	}

	if (k_sem_take(&connect_sem, K_MINUTES(LTE_CONN_TIMEOUT)) == 0) {
		set_led_state(LTE_CONNECTED_E);

		k_sleep(5000);

		cloud_publish(NO_GPS_FIX, SYNCRONIZATION, INCLUDE_MOD_D);
		lte_lc_psm_req(true);
	} else {
		set_led_state(LTE_NOT_CONNECTED_E);
		lte_lc_gps_mode();
	}
}

void main(void)
{
	printk("The cat tracker has started\n");
        struct device *port;
	port=device_get_binding(DT_GPIO_P0_DEV_NAME);
	
	gpio_pin_configure(port, 8, GPIO_DIR_OUT);


	 gpio_pin_write(port, 8, 0);
	
	work_init();
	//adxl362_init();
	watchdog_enable(&wdt_data);
	lis2dh_init();
	cloud_configuration_init();
	lte_connect();
	gps_control_init(gps_control_handler);

check_mode:
	start_restart_mov_timer();
	if (check_mode()) {
		active = true;
		goto active;
	} else {
		active = false;
		goto passive;
	}

active:
	printk("ACTIVE MODE\n");
	goto gps_search;

passive:
	printk("PASSIVE MODE\n");
	k_poll(events, 2, K_FOREVER);
	if (events[1].state == K_POLL_STATE_SEM_AVAILABLE) {
		k_sem_take(events[1].sem, 0);
	}

	goto gps_search;

gps_search:
	gps_control_start();
	k_poll(events, 1, K_SECONDS(check_gps_timeout()));
	if (events[0].state == K_POLL_STATE_SEM_AVAILABLE) {
		k_sem_take(events[0].sem, 0);
		cloud_publish(GPS_FIX, NORMAL_OPERATION, active);
	} else {
		gps_control_stop();
		cloud_publish(NO_GPS_FIX, NORMAL_OPERATION, active);
	}
	events[1].state = K_POLL_STATE_NOT_READY;
	events[0].state = K_POLL_STATE_NOT_READY;
	k_sleep(K_SECONDS(check_active_wait(active)));

	if (!lte_connected) {
		lte_connect();
	}

	goto check_mode;
}
```
