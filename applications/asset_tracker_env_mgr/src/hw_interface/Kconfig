## applications/asset_tracker_env_mgr/src/hw_interface/Kconfig
```kconfig
#
# Copyright (c) 2018 Nordic Semiconductor
#
# SPDX-License-Identifier: LicenseRef-BSD-5-Clause-Nordic
#

menu "Hardware interface modules"

rsource "Kconfig.buttons"
rsource "Kconfig.click_detector"
rsource "Kconfig.selector"
rsource "Kconfig.leds"

module = DESKTOP_BOARD
module-str = board module
source "subsys/logging/Kconfig.template.log_config"

endmenu
```

## applications/asset_tracker_env_mgr/src/modules/Kconfig
```kconfig
#
# Copyright (c) 2018 Nordic Semiconductor
#
# SPDX-License-Identifier: LicenseRef-BSD-5-Clause-Nordic
#

rsource "Kconfig.power_manager"
rsource "Kconfig.led_state"
rsource "Kconfig.shell"
rsource "Kconfig.watchdog"
rsource "Kconfig.config"
rsource "Kconfig.config_channel"
rsource "Kconfig.demo_module"
rsource "Kconfig.lte_module"
```

## applications/asset_tracker_env_mgr/src/modules/Kconfig.demo_module
```kconfig
#
# Copyright (c) 2018 Nordic Semiconductor
#
# SPDX-License-Identifier: LicenseRef-BSD-5-Clause-Nordic
#

menu "Demo module"

module = DEMO_MODULE
module-str = Demo module
source "subsys/logging/Kconfig.template.log_config"

endmenu
```

## applications/asset_tracker_env_mgr/src/modules/Kconfig.lte_module
```kconfig
#
# Copyright (c) 2018 Nordic Semiconductor
#
# SPDX-License-Identifier: LicenseRef-BSD-5-Clause-Nordic
#

menu "LTE module"

module = LTE_MODULE
module-str = LTE module
source "subsys/logging/Kconfig.template.log_config"



config MQTT_KEEPALIVE
	int
	default 1200

config CLOUD_BUTTON
	bool "Enable button sensor"
	default y

config CLOUD_BUTTON_INPUT
	int "Enable button sensor"
	range 1 4 if BOARD_NRF9160_PCA10090NS
	range 1 1 if BOARD_NRF9160_PCA20035NS
	default 1

config CLOUD_WAIT_DURATION
	int "Cloud connection acknowledge wait duration"
	default 30
	help
	    How long the device should wait for a CONNACK
	    event from the cloud.

choice
	prompt "nRF Cloud user association"
	default CLOUD_UA_BUTTONS
	help
		Select which method to use for nRF Cloud user association
		input.

config CLOUD_UA_BUTTONS
	bool "Use buttons and switches"
	help
		Use buttons and switches on the development kit to provide
		user association input.

config CLOUD_UA_CONSOLE
	bool "Use console input"
	help
		Use console to enter nRF Cloud user association input.
		Allowed input is as follows:
		'b1' = Button 1
		'b2' = Button 2
		's1' = Switch 1
		's2' = Switch 2

endchoice

config CLOUD_FOTA_APP
	bool "Enable firmware over-the-air upgrades for application"
	depends on AWS_FOTA
	depends on DFU_TARGET_MCUBOOT
	default y

config CLOUD_FOTA_MODEM
	bool "Enable firmware over-the-air upgrades for modem"
	depends on AWS_FOTA
	depends on DFU_TARGET_MODEM
	default y

endmenu
```

## applications/event_mngr_iot/cloud_client/Kconfig
```kconfig
#
# Copyright (c) 2018 Nordic Semiconductor ASA
#
# SPDX-License-Identifier: LicenseRef-BSD-5-Clause-Nordic
#

menu "nRF52 Desktop"
rsource "../common/events/Kconfig"
rsource "../common/hw_interface/Kconfig"
rsource "../common/modules/Kconfig"
rsource "src/modules/Kconfig.cloud_client_module"
endmenu

menu "Zephyr Kernel"
source "$ZEPHYR_BASE/Kconfig.zephyr"
endmenu
```

## applications/event_mngr_iot/common/events/Kconfig
```kconfig
#
# Copyright (c) 2019 Nordic Semiconductor
#
# SPDX-License-Identifier: LicenseRef-BSD-5-Clause-Nordic
#

if LOG

menu "Event options"

comment "Initially logged events"

config DESKTOP_INIT_LOG_BATTERY_STATE_EVENT
	bool "Battery state event"
	default y

config DESKTOP_INIT_LOG_BATTERY_LEVEL_EVENT
	bool "Battery level event"
	default y

config DESKTOP_INIT_LOG_BUTTON_EVENT
	bool "Button event"
	default y

config DESKTOP_INIT_LOG_CLICK_EVENT
	bool "Click event"
	default y

config DESKTOP_INIT_LOG_LED_EVENT
	bool "LED event"
	default y

config DESKTOP_INIT_LOG_LED_READY_EVENT
	bool "LED ready event"
	default y

config DESKTOP_INIT_LOG_MODULE_STATE_EVENT
	bool "Module state event"
	default y

config DESKTOP_INIT_LOG_POWER_DOWN_EVENT
	bool "Power down event"
	default y

config DESKTOP_INIT_LOG_WAKE_UP_EVENT
	bool "Wake up event"
	default y

config DESKTOP_INIT_LOG_LTE_LC_EVENT
	bool "LTE lc event"
	default y

config DESKTOP_INIT_LOG_CLOUDAPI_EVENT
	bool "Cloudapi event"
	default y

config DESKTOP_INIT_LOG_GPS_EVENT
	bool "GPS event"
	default y
endmenu

endif
```

## applications/event_mngr_iot/common/modules/Kconfig
```kconfig
#
# Copyright (c) 2018 Nordic Semiconductor
#
# SPDX-License-Identifier: LicenseRef-BSD-5-Clause-Nordic
#

rsource "Kconfig.power_manager"
rsource "Kconfig.led_state"
rsource "Kconfig.watchdog"
rsource "Kconfig.lte_lc_module"
rsource "Kconfig.cloudapi_module"
rsource "Kconfig.gps_module"
```

## applications/event_mngr_iot/common/modules/Kconfig.cloudapi_module
```kconfig
#
# Copyright (c) 2020 Nordic Semiconductor ASA
#
# SPDX-License-Identifier: LicenseRef-BSD-5-Clause-Nordic
#


menu "Cloud Client module settings"

config CLOUDAPI_MODULE_ENABLE
	bool "Enable cloud api module"
	help
	  Enable the cloud api module

if CLOUDAPI_MODULE_ENABLE

module = CLOUDAPI_MODULE
module-str = Cloud Client module
source "subsys/logging/Kconfig.template.log_config"

config CLOUD_BACKEND
	string "String that selects the cloud backend to be used"
	default "NRF_CLOUD"

config POWER_SAVING_MODE_ENABLE
	bool "Request PSM from cellular network"

endif

endmenu
```

## applications/event_mngr_iot/common/modules/Kconfig.gps_module
```kconfig
#
# Copyright (c) 2020 Nordic Semiconductor ASA
#
# SPDX-License-Identifier: LicenseRef-BSD-5-Clause-Nordic
#


menu "GPS module settings"

config GPS_MODULE_ENABLE
	bool "Enable GPS module"
	help
	  Enable the the GPS module

if GPS_MODULE_ENABLE

module = GPS_MODULE
module-str = gps module
source "subsys/logging/Kconfig.template.log_config"

endif
endmenu
```

## applications/event_mngr_iot/common/modules/Kconfig.lte_lc_module
```kconfig
#
# Copyright (c) 2020 Nordic Semiconductor ASA
#
# SPDX-License-Identifier: LicenseRef-BSD-5-Clause-Nordic
#


menu "Cloud Client module settings"

config LTE_LC_MODULE_ENABLE
	bool "Enable LTE LC module"
	help
	  Enable the the LTE link control module

if LTE_LC_MODULE_ENABLE

module = LTE_LC_MODULE
module-str = lte_lc module
source "subsys/logging/Kconfig.template.log_config"

config POWER_SAVING_MODE_ENABLE
	bool "Request PSM from cellular network"
	
endif
endmenu
```

## applications/event_mngr_iot/common/modules/Kconfig.nrf_cloud_agps_module
```kconfig
#
# Copyright (c) 2020 Nordic Semiconductor ASA
#
# SPDX-License-Identifier: LicenseRef-BSD-5-Clause-Nordic
#


menu "nRFCloud A-GPS module settings"

config NRF_CLOUD_AGPS_MODULE_ENABLE
	bool "Enable nRF Cloud A-GPS module"
	depends on NRF9160_GPS
	depends on MODEM_INFO
	depends on MODEM_INFO_ADD_NETWORK
	help
	  Enable the the nRF Cloud A-GPS module

if NRF_CLOUD_AGPS_MODULE_ENABLE

module = NRF_CLOUD_AGPS_MODULE
module-str = nRFcloud a-gps module
source "subsys/logging/Kconfig.template.log_config"

endif
endmenu
```

## applications/event_mngr_iot/nrf_cloud_agps/src/modules/Kconfig.app_module
```kconfig
#
# Copyright (c) 2020 Nordic Semiconductor ASA
#
# SPDX-License-Identifier: LicenseRef-BSD-5-Clause-Nordic
#


menu "Application module settings"

module = APP_MODULE
module-str = app module
source "subsys/logging/Kconfig.template.log_config"

config CLOUD_MESSAGE
	string "Custom message published periodically to cloud"
	default "{\"state\":{\"reported\":{\"message\":\"Hello Internet of Things!\"}}}"

endmenu
```

## boards/arm/nrf51_desktop/Kconfig.board
```kconfig
# nRF51 PCA10028 board configuration

# Copyright (c) 2016 Linaro Limited.
# SPDX-License-Identifier: Apache-2.0

config BOARD_NRF51_DESKTOP
	bool "NRF51_DESKTOP"
	depends on SOC_NRF51822_QFAC
```

## boards/arm/nrf51_desktop/Kconfig.defconfig
```kconfig
# nRF51 Desktop board configuration

# Copyright (c) 2016 Linaro Limited.
# SPDX-License-Identifier: Apache-2.0

if BOARD_NRF51_DESKTOP

config BOARD
	default "nrf51_desktop"

if ADC

config ADC_0
	default y

endif # ADC

if SPI

config SPI_0
	default y

endif # SPI

config BT_CTLR
	default BT

endif # BOARD_NRF51_DESKTOP
```

## boards/arm/nrf51_desktop/nrf51_desktop_defconfig
```kconfig
# SPDX-License-Identifier: Apache-2.0

CONFIG_ARM=y
CONFIG_SOC_FAMILY_NRF=y
CONFIG_SOC_SERIES_NRF51X=y
CONFIG_SOC_NRF51822_QFAC=y
CONFIG_BOARD_NRF51_DESKTOP=y

# enable GPIO
CONFIG_GPIO=y
```

## drivers/sensor/paw3212/Kconfig
```kconfig
# Kconfig - Sensor data simulator
#
# Copyright (c) 2019 Nordic Semiconductor
#
# SPDX-License-Identifier: LicenseRef-BSD-5-Clause-Nordic
#

menuconfig PAW3212
	bool "PAW3212 mouse optical sensor"
	help
	  Enable PAW3212 mouse optical sensor.

if PAW3212

config PAW3212_DEV_NAME
	string "PAW3212 device name"
	default "PAW3212"
	help
	  Device name for PAW3212.

config PAW3212_SPI_DEV_NAME
	string "PAW3212 SPI device"
	default "SPI_0"
	help
	  SPI device to which sensor is connected.

config PAW3212_CS_GPIO_DEV_NAME
	string "PAW3212 CS GPIO device"
	default "GPIO_0"
	help
	  Device to which CS pin is connected.

config PAW3212_CS_GPIO_PIN
	int "PAW3212 CS GPIO pin number"
	default 0
	help
	  CS pin number.

config PAW3212_IRQ_GPIO_DEV_NAME
	string "PAW3212 IRQ GPIO device"
	default "GPIO_0"
	help
	  Device to which IRQ pin is connected.

config PAW3212_IRQ_GPIO_PIN
	int "PAW3212 IRQ GPIO pin number"
	default 0
	help
	  IRQ pin number.



module = PAW3212
module-str = PAW3212
source "${ZEPHYR_BASE}/subsys/logging/Kconfig.template.log_config"

endif #PAW3212
```

## modules/memfault/Kconfig
```kconfig
#
# Copyright (c) 2021 Nordic Semiconductor ASA
#
# SPDX-License-Identifier: LicenseRef-Nordic-5-Clause
#

if MEMFAULT

config MEMFAULT_NCS_USE_DEFAULT_METRICS
	bool
	select MEMFAULT_METRICS_EXTRA_DEFS_FILE
	default y if (MEMFAULT_NCS_STACK_METRICS || MEMFAULT_NCS_LTE_METRICS)

config MEMFAULT_NCS_PROJECT_KEY
	string "Memfault API key"

config MEMFAULT_NCS_DEVICE_ID
	string "Memfault device ID"

config MEMFAULT_NCS_DEVICE_SERIAL_USE_IMEI
	bool "Use IMEI as Memfault device serial"
	depends on AT_CMD
	default y if BOARD_NRF9160DK_NRF9160NS || BOARD_THINGY91_NRF9160NS

config MEMFAULT_NCS_HW_VERSION
	string "Hardware version"
	default "nrf9160dk" if BOARD_NRF9160DK_NRF9160NS
	default "thingy91" if BOARD_THINGY91_NRF9160NS

config MEMFAULT_NCS_FW_TYPE
	string "Firmware type"
	default "nrf91-fw" if BOARD_NRF9160DK_NRF9160 || BOARD_THINGY91_NRF9160
	default "nrf91ns-fw" if BOARD_NRF9160DK_NRF9160NS || BOARD_THINGY91_NRF9160NS
	help
	  Firmware type running on the board.

choice
	prompt "Firmware version generation method"
	default MEMFAULT_NCS_FW_VERSION_AUTO

config MEMFAULT_NCS_FW_VERSION_STATIC
	bool "Static firmware version"
	help
	  Use statically configured firmware version, as opposed to an
	  dynamically generated one.

config MEMFAULT_NCS_FW_VERSION_AUTO
	bool "Dynamic firmware version"
	help
	  Use dyanimically generated firmware version. The version is
	  re-generated on every compiler run.
endchoice

config MEMFAULT_NCS_FW_VERSION_PREFIX
	string "Firmware version prefix"
	depends on MEMFAULT_NCS_FW_VERSION_AUTO
	default "0.0.1+"
	help
	  Prefix to use in front of automatically generated build version string.
	  If the build version string is "a1b2c3d", the full firmware version
	  will become "<prefix>a1b2c3d".

config MEMFAULT_NCS_INIT_PRIORITY
	int "memfault initialization priority"
	range AT_CMD_INIT_PRIORITY 99 if MEMFAULT_NCS_DEVICE_SERIAL_USE_IMEI
	default 90
	help
	  If IMEI is used as device ID, the initialization priority must be
	  greater than that of the AT command module.

config MEMFAULT_NCS_PROVISION_CERTIFICATES
	bool "Provision certificates on initalization"
	default y
	help
	  Provision required TLS root certificates for connecting to Memfault's
	  endpoints. If this option is disabled, the user is responsible for
	  calling the appropriate Memfault APIs for provisioning the
	  certificates before attempting to connect to Memfault servers.

config MEMFAULT_NCS_STACK_METRICS
	bool "Collect stack metrics"
	select THREAD_ANALYZER
	select THREAD_NAME
	default y
	help
	  Collect metrics for unused stack space for selected stacks.
	  Currently the following stacks' unused space is monitored:
		- at_cmd_socket_thread, used by the AT command library
		- connection_poll_thread, used by the cloud libraries for
		  nRF Cloud, AWS IoT and Azure IoT Hub

config MEMFAULT_NCS_STACK_CHECK_INTERVAL
	int "Stack check interval in seconds"
	depends on MEMFAULT_NCS_STACK_METRICS
	default 3600
	help
	  Stack checks are performed periodically. This configuration option
	  can be used to change how often the stack check is performed.

config MEMFAULT_NCS_LTE_METRICS
	bool "Collect LTE metrics"
	select LTE_LC_TRACE
	depends on LTE_LINK_CONTROL
	help
	  Capture LTE metrics while the application is running. Supported
	  metrics are time to connect and number of connection establishments.

config MEMFAULT_NCS_INTERNAL_FLASH_BACKED_COREDUMP
	bool "Save coredump to internal flash instead of RAM"
	select MEMFAULT_COREDUMP_STORAGE_CUSTOM
	depends on FLASH
	depends on IMG_MANAGER
	depends on BOOTLOADER_MCUBOOT
	depends on MCUBOOT_IMG_MANAGER

if MEMFAULT_NCS_INTERNAL_FLASH_BACKED_COREDUMP
partition=MEMFAULT_STORAGE
partition-size=0x40000

config PM_PARTITION_SIZE_$(partition)
	hex "Memory reserved for $(partition)"
	default $(partition-size)
	help
	  Memory set aside for the $(partition) partition.
endif # MEMFAULT_NCS_INTERNAL_FLASH_BACKED_COREDUMP

module = MEMFAULT_NCS
module-dep = LOG
module-str = Memfault NCS module
source "${ZEPHYR_BASE}/subsys/logging/Kconfig.template.log_config"


endif # MEMFAULT
```
